## boards/shields/shwiqqi_sphynx/Kconfig.defconfig
```kconfig
if SHIELD_SHWIQQI_SPHYNX

config ZMK_KEYBOARD_NAME
    default "Shwiqqi Sphynx"

endif
```

## boards/shields/shwiqqi_sphynx/Kconfig.shield
```kconfig
config SHIELD_SHWIQQI_SPHYNX
    def_bool $(shields_list_contains, shwiqqi_sphynx)
```
